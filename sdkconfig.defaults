## sdkconfig.defaults
```kconfig
#
# ANCS + A2DP + GATTS Coexistence Example Configuration
#

# Bluetooth configuration
CONFIG_BT_ENABLED=y
CONFIG_BT_BLUEDROID_ENABLED=y
CONFIG_BT_CLASSIC_ENABLED=y
CONFIG_BT_A2DP_ENABLE=y
CONFIG_BT_AVRCP_ENABLE=y
CONFIG_BT_SSP_ENABLED=y
CONFIG_BT_BLE_ENABLED=y
CONFIG_BT_GATTS_ENABLE=y
CONFIG_BT_GATTC_ENABLE=y
CONFIG_BT_SMP_ENABLE=y

# BT Controller configuration for coexistence
CONFIG_BTDM_CTRL_MODE_BTDM=y
CONFIG_BTDM_CTRL_BLE_MAX_CONN=3
CONFIG_BTDM_CTRL_BR_EDR_MAX_ACL_CONN=2
CONFIG_BTDM_CTRL_BR_EDR_SCO_DATA_PATH_HCI=y

# Bluedroid configuration
CONFIG_BT_BTC_TASK_STACK_SIZE=6144
CONFIG_BT_BLUEDROID_MEM_DEBUG=n
CONFIG_BT_CLASSIC_BQB_ENABLED=n

# A2DP configuration
CONFIG_BT_A2DP_SINK_TASK_STACK_SIZE=2048
CONFIG_BT_A2DP_SINK_AUDIO_DATA_PATH_PCM=y

# GATTS configuration
CONFIG_BT_GATTS_SEND_SERVICE_CHANGE_MANUAL=n

# Enable debug logging
CONFIG_LOG_DEFAULT_LEVEL_INFO=y

# FreeRTOS configuration
CONFIG_FREERTOS_UNICORE=n
CONFIG_FREERTOS_HZ=1000

# Memory configuration
CONFIG_MBEDTLS_DYNAMIC_BUFFER_FREERTOS_ALLOC=y
```
